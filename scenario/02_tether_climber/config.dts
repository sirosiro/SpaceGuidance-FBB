/dts-v1/;

/ {
    vfpga_reg@43C00000 {
        compatible = "generic-uio";
        reg = <0x43C00000 0x1000>;
        label = "/dev/uio0";
        registers = 
            /* 0x00 - 0x2C: Standard Hardware Control & Actuation */
            "CR_CTRL         @ 0x00 : RW",
            "SR_STATUS       @ 0x04 : RO",
            "SENSOR_RAW      @ 0x08 : RO",
            "SENSOR_EDGE     @ 0x0C : RO",
            "THRUST_CMD_X    @ 0x10 : RW",
            "THRUST_CMD_Y    @ 0x14 : RW",
            "THRUST_CMD_Z    @ 0x18 : RW",
            "TORQUE_CMD      @ 0x1C : RW",
            "SAFETY_LIMIT    @ 0x20 : RW",
            "WATCHDOG_KICK   @ 0x24 : WO",
            "CHAOS_FAULT_INJ @ 0x28 : RW",
            "WHEEL_TORQUE_CMD @ 0x2C : RW",

            /* 0x30 - 0x77: Base 2D Telemetry Export */
            "POS_X_L         @ 0x30 : RO",
            "POS_X_H         @ 0x34 : RO",
            "POS_Y_L         @ 0x38 : RO",
            "POS_Y_H         @ 0x3C : RO",
            "VEL_X_L         @ 0x40 : RO",
            "VEL_X_H         @ 0x44 : RO",
            "VEL_Y_L         @ 0x48 : RO",
            "VEL_Y_H         @ 0x4C : RO",
            "ANGLE_L         @ 0x50 : RO",
            "ANGLE_H         @ 0x54 : RO",
            "OMEGA_L         @ 0x58 : RO",
            "OMEGA_H         @ 0x5C : RO",
            "FUEL_L          @ 0x60 : RO",
            "FUEL_H          @ 0x64 : RO",
            "XT_ERR_L        @ 0x68 : RO",
            "XT_ERR_H        @ 0x6C : RO",
            "WHEEL_RPM_L     @ 0x70 : RO",
            "WHEEL_RPM_H     @ 0x74 : RO",

            /* 0x78 - 0x8C: FDIR Mode & Official Referee Engine */
            "FDIR_MODE       @ 0x78 : RW",
            "STAGE_ID        @ 0x7C : RO",
            "OFFICIAL_SCORE  @ 0x80 : RO",
            "PASSED_GATES    @ 0x84 : RO",
            "MISSION_STATUS  @ 0x88 : RO",
            "TOTAL_GATES     @ 0x8C : RO",

            /* 0x90 - 0xA7: Extended Multi-Axis Control Commands */
            "TORQUE_X_CMD    @ 0x90 : RW",
            "TORQUE_Y_CMD    @ 0x94 : RW",
            "WHEEL_TORQUE_X  @ 0x98 : RW",
            "WHEEL_TORQUE_Y  @ 0x9C : RW",
            "THRUST_VERT_CMD @ 0xA0 : RW",
            "RESERVED_A4     @ 0xA4 : RO",

            /* 0xA8 - 0xAF: Synchronization Header & Seqlock */
            "SHM_MAGIC       @ 0xA8 : RO",
            "SEQLOCK_COUNTER @ 0xAC : RO",

            /* 0xB0 - 0x127: Extended 3D Kinematics & Physical Dynamics */
            "POS_Z_L         @ 0xB0 : RO",
            "POS_Z_H         @ 0xB4 : RO",
            "VEL_Z_L         @ 0xB8 : RO",
            "VEL_Z_H         @ 0xBC : RO",
            "ROLL_L          @ 0xC0 : RO",
            "ROLL_H          @ 0xC4 : RO",
            "PITCH_L         @ 0xC8 : RO",
            "PITCH_H         @ 0xCC : RO",
            "YAW_L           @ 0xD0 : RO",
            "YAW_H           @ 0xD4 : RO",
            "OMEGA_X_L       @ 0xD8 : RO",
            "OMEGA_X_H       @ 0xDC : RO",
            "OMEGA_Y_L       @ 0xE0 : RO",
            "OMEGA_Y_H       @ 0xE4 : RO",
            "OMEGA_Z_L       @ 0xE8 : RO",
            "OMEGA_Z_H       @ 0xEC : RO",
            "WHEEL_RPM_X_L   @ 0xF0 : RO",
            "WHEEL_RPM_X_H   @ 0xF4 : RO",
            "WHEEL_RPM_Y_L   @ 0xF8 : RO",
            "WHEEL_RPM_Y_H   @ 0xFC : RO",
            "WHEEL_RPM_Z_L   @ 0x100 : RO",
            "WHEEL_RPM_Z_H   @ 0x104 : RO",
            "CABLE_TENSION_L @ 0x108 : RO",
            "CABLE_TENSION_H @ 0x10C : RO",
            "CABLE_VIB_L     @ 0x110 : RO",
            "CABLE_VIB_H     @ 0x114 : RO",
            "DETUMBLE_TIME_L @ 0x118 : RO",
            "DETUMBLE_TIME_H @ 0x11C : RO",
            "ELAPSED_TIME_L  @ 0x120 : RO",
            "ELAPSED_TIME_H  @ 0x124 : RO",

            /* 0x128 - 0x167: Mission Specific Dynamics */
            "DEBRIS_AZIM_L   @ 0x128 : RO",
            "DEBRIS_AZIM_H   @ 0x12C : RO",
            "DEBRIS_ELEV_L   @ 0x130 : RO",
            "DEBRIS_ELEV_H   @ 0x134 : RO",
            "DEBRIS_SPWN_X_L @ 0x138 : RO",
            "DEBRIS_SPWN_X_H @ 0x13C : RO",
            "DEBRIS_SPWN_Y_L @ 0x140 : RO",
            "DEBRIS_SPWN_Y_H @ 0x144 : RO",
            "DEBRIS_SPWN_Z_L @ 0x148 : RO",
            "DEBRIS_SPWN_Z_H @ 0x14C : RO",
            "DEBRIS_IMP_X_L  @ 0x150 : RO",
            "DEBRIS_IMP_X_H  @ 0x154 : RO",
            "DEBRIS_IMP_Y_L  @ 0x158 : RO",
            "DEBRIS_IMP_Y_H  @ 0x15C : RO",
            "DEBRIS_IMP_Z_L  @ 0x160 : RO",
            "DEBRIS_IMP_Z_H  @ 0x164 : RO",

            /* 0x168 - 0x18F: Scores & Status Flags */
            "CHECKPOINT_PTS  @ 0x168 : RO",
            "BONUS_PTS       @ 0x16C : RO",
            "CABLE_SNAPPED   @ 0x170 : RO",
            "THRUST_HEALTH   @ 0x174 : RO",
            "IS_DETUMBLED    @ 0x178 : RO",
            "DEBRIS_HITS     @ 0x17C : RO",
            "CHAOS_SEED      @ 0x180 : RO",
            "DMG_THRUST_1    @ 0x184 : RO",
            "DMG_THRUST_2    @ 0x188 : RO",
            "MISSION_CODE    @ 0x18C : RO",

            /* 0x190 - 0x1EF: Strings & Buffers */
            "GRADE_STR_0     @ 0x190 : RO",
            "GRADE_STR_1     @ 0x194 : RO",
            "GRADE_STR_2     @ 0x198 : RO",
            "GRADE_STR_3     @ 0x19C : RO",
            "GRADE_STR_4     @ 0x1A0 : RO",
            "GRADE_STR_5     @ 0x1A4 : RO",
            "GRADE_STR_6     @ 0x1A8 : RO",
            "GRADE_STR_7     @ 0x1AC : RO",
            "EVENT_STR_0     @ 0x1B0 : RO",
            "EVENT_STR_1     @ 0x1B4 : RO",
            "EVENT_STR_2     @ 0x1B8 : RO",
            "EVENT_STR_3     @ 0x1BC : RO",
            "EVENT_STR_4     @ 0x1C0 : RO",
            "EVENT_STR_5     @ 0x1C4 : RO",
            "EVENT_STR_6     @ 0x1C8 : RO",
            "EVENT_STR_7     @ 0x1CC : RO",
            "EVENT_STR_8     @ 0x1D0 : RO",
            "EVENT_STR_9     @ 0x1D4 : RO",
            "EVENT_STR_10    @ 0x1D8 : RO",
            "EVENT_STR_11    @ 0x1DC : RO",
            "EVENT_STR_12    @ 0x1E0 : RO",
            "EVENT_STR_13    @ 0x1E4 : RO",
            "EVENT_STR_14    @ 0x1E8 : RO",
            "EVENT_STR_15    @ 0x1EC : RO";
    };

    uart0: serial@e0001000 {
        compatible = "xlnx,xuartps";
        reg = <0xe0001000 0x1000>;
        label = "/dev/ttyPS1";
    };
};
