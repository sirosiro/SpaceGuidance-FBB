/dts-v1/;

/ {
    vfpga_reg: vfpga_reg@43C00000 {
        compatible = "generic-uio";
        reg = <0x43C00000 0x1000>;
        label = "/dev/uio0";
    };

    uart0: serial@e0001000 {
        compatible = "xlnx,xuartps";
        reg = <0xe0001000 0x1000>;
        label = "/dev/ttyPS1";
    };
};
